## drivers/dma-buf/Kconfig
```kconfig
menu "DMABUF options"

config SYNC_FILE
	bool "Explicit Synchronization Framework"
	default n
	select DMA_SHARED_BUFFER
	---help---
	  The Sync File Framework adds explicit syncronization via
	  userspace. It enables send/receive 'struct dma_fence' objects to/from
	  userspace via Sync File fds for synchronization between drivers via
	  userspace components. It has been ported from Android.

	  The first and main user for this is graphics in which a fence is
	  associated with a buffer. When a job is submitted to the GPU a fence
	  is attached to the buffer and is transferred via userspace, using Sync
	  Files fds, to the DRM driver for example. More details at
	  Documentation/sync_file.txt.

config SW_SYNC
	bool "Sync File Validation Framework"
	default n
	depends on SYNC_FILE
	depends on DEBUG_FS
	---help---
	  A sync object driver that uses a 32bit counter to coordinate
	  synchronization.  Useful when there is no hardware primitive backing
	  the synchronization.

	  WARNING: improper use of this can result in deadlocking kernel
	  drivers from userspace. Intended for test and debug only.

config DEBUG_DMA_BUF_REF
	bool "DEBUG Reference Count"
	select STACKDEPOT
	depends on DMA_SHARED_BUFFER
	default n
	---help---
	  Save stack traces for every call to dma_buf_get and dma_buf_put, to
	  help debug memory leaks. Potential leaks may be found by manually
	  matching the get/put call stacks.  This feature consumes extra memory
	  in order to save the stack traces using STACKDEPOT.

	  Read the results from /sys/kernel/debug/dma_buf/bufinfo, which
	  requires CONFIG_DEBUG_FS.

menuconfig DMABUF_HEAPS
	bool "DMA-BUF Userland Memory Heaps"
	select DMA_SHARED_BUFFER
	help
	  Choose this option to enable the DMA-BUF userland memory heaps.
	  This options creates per heap chardevs in /dev/dma_heap/ which
	  allows userspace to allocate dma-bufs that can be shared
	  between drivers.

source "drivers/dma-buf/heaps/Kconfig"

endmenu
```
